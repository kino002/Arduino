#include <Wire.h>
#include <IRremote.h>

IRsend irsend;
int SLAVE_ADDRESS = 0x04;   //I2Cのアドレス『0x04』

byte cmd = 0x00;
byte cmd2 = 0x00;

int khz = 38; // 38kHz carrier frequency for the NEC protocol

// LEDライト　ON
int LED_ON[75] = {3400,1700, 400,1250, 400,1300, 400,450, 400,400, 400,1300, 400,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1300, 400};

// LEDライト OFF
int LED_OFF[75] = {3400,1700, 400,1300, 400,1250, 400,450, 400,400, 400,1300, 400,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1300, 400};

// LEDライト　豆電球 
int LED_MAME[75] = {3400,1700, 400,1250, 400,1300, 400,400, 450,400, 400,1300, 400,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1250, 400};




/*setupは起動後ときに最小に呼び出される関数でここで初期化の処理を行います*/
void setup() {
   //シリアル通信の初期化しシリアルモニタへ文字列を出力できるようにする　9600はボーレート(通信速度)
   Serial.begin(9600);

  //I2C接続を開始する 
  Wire.begin(SLAVE_ADDRESS);

  //I2Cで受信するたびに呼び出す関数を登録する
  Wire.onReceive(ReceiveMassage);

  Serial.println("stand by OK");

}

/*setupの後、終了するまで繰り返し呼び出される関数です*/
void loop() {
  
  if(cmd == 0x80){
    if(cmd2 == 'A'){
      irsend.sendRaw(LED_ON, sizeof(LED_ON) / sizeof(LED_ON[0]), khz);
      Serial.println("LED_ON");
      cmd2 = 0x00;
    }
    else if(cmd2 == 'B'){
      irsend.sendRaw(LED_OFF, sizeof(LED_OFF) / sizeof(LED_OFF[0]), khz);
      Serial.println("LED_OFF");
      cmd2 = 0x00;
    }
    else if(cmd2 == 'C'){
      irsend.sendRaw(LED_MAME, sizeof(LED_MAME) / sizeof(LED_MAME[0]), khz);
      Serial.println("LED_MAME");
      cmd2 = 0x00;
    }
    
    
    cmd = 0x00;
  }
}

/*setupの後、終了するまで繰り返し呼び出される関数です (int n)は、送られてきたデータの数*/
void ReceiveMassage(int n){
  
  // cmdを受信
  
  cmd = Wire.read();
  
  cmd2 = Wire.read();
  Serial.println(cmd);
  Serial.println(cmd2);
}
