#include <Wire.h>
#include <IRremote.h>

IRsend irsend;
int SLAVE_ADDRESS = 0x04;   //I2Cのアドレス『0x04』

byte cmd = 0x00;
byte cmd2 = 0x00;

int khz = 38; // 38kHz carrier frequency for the NEC protocol


// エアコン　暖房
int AC_DAN[100] = {3400,1650, 400,1250, 400,450, 400,450, 400,400, 400,450, 400,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 400,450 };

// エアコン　冷房
int AC_REI[100] = {3350,1650, 400,1300, 400,400, 400,450, 400,450, 400,400, 400,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 400,400 };

// エアコン　停止
int AC_STOP[100] = {3350,1650, 450,1250, 400,400, 400,450, 400,450, 400,400, 400,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 450,400 };



/*setupは起動後ときに最小に呼び出される関数でここで初期化の処理を行います*/
void setup() {
   //シリアル通信の初期化しシリアルモニタへ文字列を出力できるようにする　9600はボーレート(通信速度)
   Serial.begin(9600);

  //I2C接続を開始する 
  Wire.begin(SLAVE_ADDRESS);

  //I2Cで受信するたびに呼び出す関数を登録する
  Wire.onReceive(ReceiveMassage);
  Serial.println("stand by OK");

}

/*setupの後、終了するまで繰り返し呼び出される関数です*/
void loop() {
  
  if(cmd == 0x80){
    
    if(cmd2 == 'A'){
      irsend.sendRaw(AC_DAN, sizeof(AC_DAN) / sizeof(AC_DAN[0]), khz);
      Serial.println("AC_DAN");
      cmd2 = 0x00;
    }

    else if(cmd2 == 'B'){
      irsend.sendRaw(AC_REI, sizeof(AC_REI) / sizeof(AC_REI[0]), khz);
      Serial.println("AC_REI");
      cmd2 = 0x00;
    }

    else if(cmd2 == 'C'){
      irsend.sendRaw(AC_STOP, sizeof(AC_STOP) / sizeof(AC_STOP[0]), khz);
      Serial.println("AC_STOP");
      cmd2 = 0x00;
    }
    cmd = 0x00;
  }
}

/*setupの後、終了するまで繰り返し呼び出される関数です (int n)は、送られてきたデータの数*/
void ReceiveMassage(int n){
  
  // cmdを受信
  
  cmd = Wire.read();
  
  cmd2 = Wire.read();
  Serial.println(cmd);
  Serial.println(cmd2);
}
